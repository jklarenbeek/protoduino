/* AUTO-GENERATED by tools/ontology-sync.js -- DO NOT EDIT.
 * Source of truth: src/sys/errors.h (names + comment descriptions).
 * Regenerate: node tools/ontology-sync.js
 *
 * This file is a switch body. The including file must define
 *   S(tiny, verbose)
 * selecting one literal and wrapping it in PSTR() so every string
 * is flash-resident (PROGMEM on AVR); nothing is placed in SRAM.
 */
case ERR_SUCCESS: return S("SUCCESS", "Operation completed successfully"); /* also: ERR_OK */
case ERR_YIELDING: return S("YIELDING", "Process yielded control (waiting for event)"); /* also: ERR_SYS_STATE */
case ERR_EXITING: return S("EXITING", "Process exited externally"); /* also: ERR_SYS_ACCESS */
case ERR_ENDING: return S("ENDING", "Process terminated normally"); /* also: ERR_SYS_HANDLE */
case ERR_ACCESS_DENIED: return S("ACCESS_DENIED", "Access denied");
case ERR_ACCESS_READONLY: return S("ACCESS_READONLY", "Write to readonly");
case ERR_HANDLE_INVALID: return S("HANDLE_INVALID", "Invalid handle");
case ERR_HANDLE_CLOSED: return S("HANDLE_CLOSED", "Handle already closed");
case ERR_SOCK_CREATE: return S("SOCK_CREATE", "Socket create failed");
case ERR_SOCK_BIND: return S("SOCK_BIND", "Bind failed");
case ERR_CONN_REFUSED: return S("CONN_REFUSED", "Connection refused");
case ERR_CONN_RESET: return S("CONN_RESET", "Connection reset");
case ERR_IRQ_DISABLED: return S("IRQ_DISABLED", "IRQ disabled");
case ERR_IRQ_PENDING: return S("IRQ_PENDING", "IRQ pending");
case ERR_CLK_NOT_READY: return S("CLK_NOT_READY", "Clock not ready");
case ERR_CLK_UNSTABLE: return S("CLK_UNSTABLE", "Clock unstable");
case ERR_TEXT_ENCODE: return S("TEXT_ENCODE", "Encoding error");
case ERR_TEXT_DECODE: return S("TEXT_DECODE", "Decode error");
case ERR_STRUCT_SYNTAX: return S("STRUCT_SYNTAX", "JSON/YAML syntax");
case ERR_STRUCT_TYPE: return S("STRUCT_TYPE", "JSON/YAML type error");
case ERR_NET_SOCK: return S("NET_SOCK", "NET_SOCK");
case ERR_NET_CONN: return S("NET_CONN", "NET_CONN");
case ERR_TIME_IRQ: return S("TIME_IRQ", "TIME_IRQ");
case ERR_TIME_CLOCK: return S("TIME_CLOCK", "TIME_CLOCK");
case ERR_FILE_NOT_FOUND: return S("FILE_NOT_FOUND", "File not found");
case ERR_FILE_EXISTS: return S("FILE_EXISTS", "File exists");
case ERR_ATTR_READONLY: return S("ATTR_READONLY", "Read-only");
case ERR_ATTR_HIDDEN: return S("ATTR_HIDDEN", "Hidden");
case ERR_AUTH_FAILED: return S("AUTH_FAILED", "Auth failed");
case ERR_AUTH_EXPIRED: return S("AUTH_EXPIRED", "Token expired");
case ERR_ENCRYPT_FAILED: return S("ENCRYPT_FAILED", "Encryption failed");
case ERR_DECRYPT_FAILED: return S("DECRYPT_FAILED", "Decryption failed");
case ERR_HEAP_OOM: return S("HEAP_OOM", "Out of memory");
case ERR_HEAP_FRAGMENT: return S("HEAP_FRAGMENT", "Fragmented");
case ERR_STACK_OVERFLOW: return S("STACK_OVERFLOW", "Stack overflow");
case ERR_STACK_UNDERFLOW: return S("STACK_UNDERFLOW", "Stack underflow");
case ERR_INIT_FAILED: return S("INIT_FAILED", "Init failed");
case ERR_INIT_TIMEOUT: return S("INIT_TIMEOUT", "Init timeout");
case ERR_STATE_INVALID: return S("STATE_INVALID", "Invalid state");
case ERR_STATE_TRANSITION: return S("STATE_TRANSITION", "Bad transition");
case ERR_PARSE_TEXT: return S("PARSE_TEXT", "PARSE_TEXT");
case ERR_PARSE_STRUCT: return S("PARSE_STRUCT", "PARSE_STRUCT");
case ERR_NET_DOM: return S("NET_DOM", "NET_DOM");
case ERR_TIME_DOM: return S("TIME_DOM", "TIME_DOM");
case ERR_SERIAL_BAUD: return S("SERIAL_BAUD", "Baud rate error");
case ERR_SERIAL_FRAME: return S("SERIAL_FRAME", "Frame error");
case ERR_BUS_NACK: return S("BUS_NACK", "NACK received");
case ERR_BUS_ARBITRATION: return S("BUS_ARBITRATION", "Arbitration lost");
case ERR_QUEUE_EMPTY: return S("QUEUE_EMPTY", "Queue empty");
case ERR_QUEUE_FULL: return S("QUEUE_FULL", "Queue full");
case ERR_QUEUE_ENQUEUE: return S("QUEUE_ENQUEUE", "Enqueue failed");
case ERR_QUEUE_DEQUEUE: return S("QUEUE_DEQUEUE", "Dequeue failed");
case ERR_ARITH_DIV_ZERO: return S("ARITH_DIV_ZERO", "Division by zero");
case ERR_ARITH_OVERFLOW: return S("ARITH_OVERFLOW", "Overflow");
case ERR_FLOAT_NAN: return S("FLOAT_NAN", "Result is NaN");
case ERR_FLOAT_INF: return S("FLOAT_INF", "Result is infinity");
case ERR_LOCK_FAILED: return S("LOCK_FAILED", "Lock failed");
case ERR_LOCK_TIMEOUT: return S("LOCK_TIMEOUT", "Lock timeout");
case ERR_PIPE_BROKEN: return S("PIPE_BROKEN", "Broken pipe");
case ERR_PIPE_FULL: return S("PIPE_FULL", "Pipe Full");
case ERR_STORAGE_FILE: return S("STORAGE_FILE", "STORAGE_FILE");
case ERR_STORAGE_ATTR: return S("STORAGE_ATTR", "STORAGE_ATTR");
case ERR_SEC_AUTH: return S("SEC_AUTH", "SEC_AUTH");
case ERR_SEC_ENCRYPT: return S("SEC_ENCRYPT", "SEC_ENCRYPT");
case ERR_MEM_HEAP: return S("MEM_HEAP", "MEM_HEAP");
case ERR_MEM_BOUNDS: return S("MEM_BOUNDS", "MEM_BOUNDS");
case ERR_LIFE_INIT: return S("LIFE_INIT", "LIFE_INIT");
case ERR_LIFE_STATE: return S("LIFE_STATE", "LIFE_STATE");
case ERR_PROC_CANCELLED: return S("PROC_CANCELLED", "Operation cancelled");
case ERR_PROC_KILLED: return S("PROC_KILLED", "Process killed");
case ERR_ARG_NULL: return S("ARG_NULL", "NULL argument");
case ERR_ARG_INVALID: return S("ARG_INVALID", "Invalid argument");
case ERR_DNS_NXDOMAIN: return S("DNS_NXDOMAIN", "Domain not found");
case ERR_DNS_TIMEOUT: return S("DNS_TIMEOUT", "Resolution timeout");
case ERR_PROTO_VERSION: return S("PROTO_VERSION", "Protocol version");
case ERR_PROTO_FORMAT: return S("PROTO_FORMAT", "Format error");
case ERR_SYNC_FAILED: return S("SYNC_FAILED", "Sync failed");
case ERR_SYNC_TIMEOUT: return S("SYNC_TIMEOUT", "Sync timeout");
case ERR_WDT_EXPIRED: return S("WDT_EXPIRED", "Watchdog expired");
case ERR_WDT_RESET: return S("WDT_RESET", "Watchdog reset");
case ERR_BIN_HEADER: return S("BIN_HEADER", "Bad header");
case ERR_BIN_MAGIC: return S("BIN_MAGIC", "Magic mismatch");
case ERR_VALID_SCHEMA: return S("VALID_SCHEMA", "Schema violation");
case ERR_VALID_CONSTRAINT: return S("VALID_CONSTRAINT", "Constraint fail");
case ERR_PARSE_DOM: return S("PARSE_DOM", "PARSE_DOM");
case ERR_IO_BUSY: return S("IO_BUSY", "Resource busy");
case ERR_IO_SERIAL: return S("IO_SERIAL", "IO_SERIAL");
case ERR_IO_BUS: return S("IO_BUS", "IO_BUS");
case ERR_VOL_NOT_MOUNTED: return S("VOL_NOT_MOUNTED", "Not mounted");
case ERR_VOL_BUSY: return S("VOL_BUSY", "Volume busy");
case ERR_BLK_READ_ERROR: return S("BLK_READ_ERROR", "Read error");
case ERR_BLK_WRITE_ERROR: return S("BLK_WRITE_ERROR", "Write error");
case ERR_POLICY_VIOLATION: return S("POLICY_VIOLATION", "Policy violation");
case ERR_POLICY_DENY: return S("POLICY_DENY", "Explicit deny");
case ERR_AUDIT_FAILED: return S("AUDIT_FAILED", "Audit failed");
case ERR_AUDIT_FULL: return S("AUDIT_FULL", "Audit log full");
case ERR_BUF_OVERFLOW: return S("BUF_OVERFLOW", "Buffer overflow");
case ERR_BUF_UNDERFLOW: return S("BUF_UNDERFLOW", "Buffer underflow");
case ERR_ALIGN_ADDR: return S("ALIGN_ADDR", "Misaligned address");
case ERR_ALIGN_SIZE: return S("ALIGN_SIZE", "Misaligned size");
case ERR_REF_ZERO: return S("REF_ZERO", "Ref count zero");
case ERR_REF_OVERFLOW: return S("REF_OVERFLOW", "Ref count overflow");
case ERR_CLEAN_FAILED: return S("CLEAN_FAILED", "Cleanup failed");
case ERR_CLEAN_PARTIAL: return S("CLEAN_PARTIAL", "Partial cleanup");
case ERR_QUEUE_STATE: return S("QUEUE_STATE", "QUEUE_STATE");
case ERR_QUEUE_OP: return S("QUEUE_OP", "QUEUE_OP");
case ERR_MATH_ARITH: return S("MATH_ARITH", "MATH_ARITH");
case ERR_MATH_FLOAT: return S("MATH_FLOAT", "MATH_FLOAT");
case ERR_ADC_SATURATED: return S("ADC_SATURATED", "ADC saturated");
case ERR_ADC_TIMEOUT: return S("ADC_TIMEOUT", "ADC timeout");
case ERR_GPIO_CONFIG: return S("GPIO_CONFIG", "Config error");
case ERR_GPIO_LOCKED: return S("GPIO_LOCKED", "Pin locked");
case ERR_ORDER_SEQUENCE: return S("ORDER_SEQUENCE", "Sequence error");
case ERR_ORDER_PRIORITY: return S("ORDER_PRIORITY", "Priority error");
case ERR_COLL_LOCKED: return S("COLL_LOCKED", "Collection locked");
case ERR_COLL_MODIFIED: return S("COLL_MODIFIED", "Modified during iteration");
case ERR_LOGIC_ASSERT: return S("LOGIC_ASSERT", "Assertion failed");
case ERR_LOGIC_INVARIANT: return S("LOGIC_INVARIANT", "Invariant broken");
case ERR_CRYPTO_KEY: return S("CRYPTO_KEY", "Invalid key");
case ERR_CRYPTO_IV: return S("CRYPTO_IV", "Invalid IV");
case ERR_ATOMIC_FAILED: return S("ATOMIC_FAILED", "Atomic op failed");
case ERR_ATOMIC_RACE: return S("ATOMIC_RACE", "Race detected");
case ERR_CRIT_ENTER: return S("CRIT_ENTER", "Enter failed");
case ERR_CRIT_EXIT: return S("CRIT_EXIT", "Exit failed");
case ERR_LOCK_STATE: return S("LOCK_STATE", "LOCK_STATE");
case ERR_LOCK_IPC: return S("LOCK_IPC", "LOCK_IPC");
case ERR_STORAGE_DOM: return S("STORAGE_DOM", "STORAGE_DOM");
case ERR_SEC_DOM: return S("SEC_DOM", "SEC_DOM");
case ERR_MEM_DOM: return S("MEM_DOM", "MEM_DOM");
case ERR_LIFE_DOM: return S("LIFE_DOM", "LIFE_DOM");
case ERR_SYS_PROC: return S("SYS_PROC", "SYS_PROC");
case ERR_SYS_ARGUMENT: return S("SYS_ARGUMENT", "SYS_ARGUMENT");
case ERR_ACCESS_LOCKED: return S("ACCESS_LOCKED", "Resource locked");
case ERR_ACCESS_FORBIDDEN: return S("ACCESS_FORBIDDEN", "Forbidden operation");
case ERR_HANDLE_TYPE: return S("HANDLE_TYPE", "Wrong handle type");
case ERR_HANDLE_SHADOW: return S("HANDLE_SHADOW", "Stale/ghost handle");
case ERR_SOCK_LISTEN: return S("SOCK_LISTEN", "Listen failed");
case ERR_SOCK_ACCEPT: return S("SOCK_ACCEPT", "Accept failed");
case ERR_CONN_CLOSED: return S("CONN_CLOSED", "Connection closed");
case ERR_CONN_TIMEOUT: return S("CONN_TIMEOUT", "Connection timeout");
case ERR_IRQ_NESTED: return S("IRQ_NESTED", "Nested overflow");
case ERR_IRQ_PRIORITY: return S("IRQ_PRIORITY", "Priority error");
case ERR_CLK_EXPIRED: return S("CLK_EXPIRED", "Timer expired");
case ERR_CLK_OVERFLOW: return S("CLK_OVERFLOW", "Timer overflow");
case ERR_TEXT_TRUNC: return S("TEXT_TRUNC", "Truncated");
case ERR_TEXT_INVALID: return S("TEXT_INVALID", "Invalid text");
case ERR_STRUCT_MALFORMED: return S("STRUCT_MALFORMED", "JSON/XML malformed");
case ERR_STRUCT_NAMESPACE: return S("STRUCT_NAMESPACE", "JSON/XML namespace");
case ERR_NET_DNS: return S("NET_DNS", "NET_DNS");
case ERR_NET_PROTO: return S("NET_PROTO", "NET_PROTO");
case ERR_TIME_SYNC: return S("TIME_SYNC", "TIME_SYNC");
case ERR_TIME_WDT: return S("TIME_WDT", "TIME_WDT");
case ERR_FILE_TOO_LARGE: return S("FILE_TOO_LARGE", "File too large");
case ERR_FILE_CORRUPTED: return S("FILE_CORRUPTED", "File corrupted");
case ERR_ATTR_SYSTEM: return S("ATTR_SYSTEM", "System file");
case ERR_ATTR_DIRECTORY: return S("ATTR_DIRECTORY", "Is directory");
case ERR_AUTH_REVOKED: return S("AUTH_REVOKED", "Credentials revoked");
case ERR_AUTH_INSUFFICIENT: return S("AUTH_INSUFFICIENT", "Insufficient rights");
case ERR_ENCRYPT_KEY_INVALID: return S("ENCRYPT_KEY_INVALID", "Invalid key");
case ERR_ENCRYPT_ALGO: return S("ENCRYPT_ALGO", "Unsupported algo");
case ERR_HEAP_CORRUPT: return S("HEAP_CORRUPT", "Heap corrupted");
case ERR_HEAP_DOUBLE_FREE: return S("HEAP_DOUBLE_FREE", "Double free");
case ERR_BOUNDS_LOWER: return S("BOUNDS_LOWER", "Lower bound");
case ERR_BOUNDS_UPPER: return S("BOUNDS_UPPER", "Upper bound");
case ERR_INIT_DEPENDENCY: return S("INIT_DEPENDENCY", "Missing dependency");
case ERR_INIT_NOSUP: return S("INIT_NOSUP", "Already initialized");
case ERR_STATE_LOCKED: return S("STATE_LOCKED", "State locked");
case ERR_STATE_FROZEN: return S("STATE_FROZEN", "State frozen");
case ERR_PARSE_BINARY: return S("PARSE_BINARY", "PARSE_BINARY");
case ERR_PARSE_VALID: return S("PARSE_VALID", "PARSE_VALID");
case ERR_DATA_ROOT: return S("DATA_ROOT", "Data error");
case ERR_IO_DOM: return S("IO_DOM", "IO_DOM");
case ERR_SERIAL_PARITY: return S("SERIAL_PARITY", "Parity error");
case ERR_SERIAL_OVERRUN: return S("SERIAL_OVERRUN", "Overrun");
case ERR_BUS_TIMEOUT: return S("BUS_TIMEOUT", "Bus timeout");
case ERR_BUS_ERROR: return S("BUS_ERROR", "Bus error");
case ERR_QUEUE_OVERFLOW: return S("QUEUE_OVERFLOW", "Overflow");
case ERR_QUEUE_UNDERFLOW: return S("QUEUE_UNDERFLOW", "Underflow");
case ERR_QUEUE_PEEK: return S("QUEUE_PEEK", "Peek failed");
case ERR_QUEUE_CLEAR: return S("QUEUE_CLEAR", "Clear failed");
case ERR_ARITH_UNDERFLOW: return S("ARITH_UNDERFLOW", "Underflow");
case ERR_ARITH_PRECISION: return S("ARITH_PRECISION", "Precision loss");
case ERR_FLOAT_DENORM: return S("FLOAT_DENORM", "Denormalized");
case ERR_FLOAT_INEXACT: return S("FLOAT_INEXACT", "Inexact result");
case ERR_LOCK_DEADLOCK: return S("LOCK_DEADLOCK", "Deadlock detected");
case ERR_LOCK_OWNER: return S("LOCK_OWNER", "Wrong owner");
case ERR_MSG_SIZE: return S("MSG_SIZE", "Message Too Large");
case ERR_MSG_QUEUE: return S("MSG_QUEUE", "Queue Destroyed");
case ERR_STORAGE_VOLUME: return S("STORAGE_VOLUME", "STORAGE_VOLUME");
case ERR_STORAGE_BLOCK: return S("STORAGE_BLOCK", "STORAGE_BLOCK");
case ERR_SEC_POLICY: return S("SEC_POLICY", "SEC_POLICY");
case ERR_SEC_AUDIT: return S("SEC_AUDIT", "SEC_AUDIT");
case ERR_MEM_BUFFER: return S("MEM_BUFFER", "MEM_BUFFER");
case ERR_MEM_ALIGN: return S("MEM_ALIGN", "MEM_ALIGN");
case ERR_LIFE_REF: return S("LIFE_REF", "LIFE_REF");
case ERR_LIFE_CLEAN: return S("LIFE_CLEAN", "LIFE_CLEAN");
case ERR_PROC_ORPHAN: return S("PROC_ORPHAN", "Orphaned process");
case ERR_PROC_ZOMBIE: return S("PROC_ZOMBIE", "Zombie process");
case ERR_ARG_RANGE: return S("ARG_RANGE", "Arg out of range");
case ERR_ARG_TYPE: return S("ARG_TYPE", "Type mismatch");
case ERR_DNS_SERVFAIL: return S("DNS_SERVFAIL", "Server failure");
case ERR_DNS_CONFIG: return S("DNS_CONFIG", "DNS config error");
case ERR_PROTO_SEQUENCE: return S("PROTO_SEQUENCE", "Sequence error");
case ERR_PROTO_STATE: return S("PROTO_STATE", "Protocol state");
case ERR_SYNC_BARRIER: return S("SYNC_BARRIER", "Barrier broken");
case ERR_SYNC_LOST: return S("SYNC_LOST", "Sync lost");
case ERR_WDT_EARLY: return S("WDT_EARLY", "Early kick");
case ERR_WDT_CONFIG: return S("WDT_CONFIG", "WDT config error");
case ERR_BIN_VERSION: return S("BIN_VERSION", "Version mismatch");
case ERR_BIN_CHECKSUM: return S("BIN_CHECKSUM", "Checksum fail");
case ERR_VALID_PATTERN: return S("VALID_PATTERN", "Pattern mismatch");
case ERR_VALID_REQUIRED: return S("VALID_REQUIRED", "Required missing");
case ERR_QUEUE_DOM: return S("QUEUE_DOM", "QUEUE_DOM");
case ERR_MATH_DOM: return S("MATH_DOM", "MATH_DOM");
case ERR_IO_ANALOG: return S("IO_ANALOG", "IO_ANALOG");
case ERR_IO_GPIO: return S("IO_GPIO", "IO_GPIO");
case ERR_VOL_FULL: return S("VOL_FULL", "Volume full");
case ERR_VOL_CORRUPTED: return S("VOL_CORRUPTED", "Corrupted");
case ERR_BLK_BAD_SECTOR: return S("BLK_BAD_SECTOR", "Bad sector");
case ERR_BLK_HARDWARE: return S("BLK_HARDWARE", "Hardware error");
case ERR_POLICY_QUOTA: return S("POLICY_QUOTA", "Quota exceeded");
case ERR_POLICY_RATE_LIMIT: return S("POLICY_RATE_LIMIT", "Rate limited");
case ERR_AUDIT_TAMPER: return S("AUDIT_TAMPER", "Tamper detected");
case ERR_AUDIT_INTEGRITY: return S("AUDIT_INTEGRITY", "Integrity fail");
case ERR_BUF_FULL: return S("BUF_FULL", "Buffer full");
case ERR_BUF_EMPTY: return S("BUF_EMPTY", "Buffer empty");
case ERR_PAGE_FAULT: return S("PAGE_FAULT", "Page fault");
case ERR_PAGE_PROTECT: return S("PAGE_PROTECT", "Page protection");
case ERR_REF_LEAK: return S("REF_LEAK", "Memory leak");
case ERR_REF_DANGLING: return S("REF_DANGLING", "Dangling pointer");
case ERR_CLEAN_BUSY: return S("CLEAN_BUSY", "Resource busy");
case ERR_CLEAN_LEAKED: return S("CLEAN_LEAKED", "Resource leaked");
case ERR_QUEUE_ORDER: return S("QUEUE_ORDER", "QUEUE_ORDER");
case ERR_COLLECTION_STATE: return S("COLLECTION_STATE", "COLLECTION_STATE");
case ERR_MATH_LOGIC: return S("MATH_LOGIC", "MATH_LOGIC");
case ERR_MATH_CRYPTO: return S("MATH_CRYPTO", "MATH_CRYPTO");
case ERR_DAC_UNDERRUN: return S("DAC_UNDERRUN", "DAC underrun");
case ERR_DAC_CONFIG: return S("DAC_CONFIG", "DAC config");
case ERR_GPIO_STATE: return S("GPIO_STATE", "Invalid state");
case ERR_GPIO_INTERRUPT: return S("GPIO_INTERRUPT", "IRQ error");
case ERR_ORDER_DUPLICATE: return S("ORDER_DUPLICATE", "Duplicate entry");
case ERR_ORDER_CONFLICT: return S("ORDER_CONFLICT", "Order conflict");
case ERR_COLL_INDEX: return S("COLL_INDEX", "Index out of bounds");
case ERR_COLL_KEY: return S("COLL_KEY", "Key not found");
case ERR_LOGIC_UNREACH: return S("LOGIC_UNREACH", "Unreachable code");
case ERR_LOGIC_IMPOSSIBLE: return S("LOGIC_IMPOSSIBLE", "Impossible state");
case ERR_CRYPTO_TAG: return S("CRYPTO_TAG", "Tag verification");
case ERR_CRYPTO_PADDING: return S("CRYPTO_PADDING", "Padding error");
case ERR_ATOMIC_MEMORY_ORDER: return S("ATOMIC_MEMORY_ORDER", "Memory order");
case ERR_ATOMIC_CONTENTION: return S("ATOMIC_CONTENTION", "High contention");
case ERR_CRIT_NESTED: return S("CRIT_NESTED", "Nested overflow");
case ERR_CRIT_ABANDONED: return S("CRIT_ABANDONED", "Abandoned");
case ERR_LOCK_ATOMIC: return S("LOCK_ATOMIC", "LOCK_ATOMIC");
case ERR_LOCK_CRITICAL: return S("LOCK_CRITICAL", "LOCK_CRITICAL");
case ERR_DEADLOCK: return S("DEADLOCK", "DEADLOCK");
case ERR_FINALIZED: return S("FINALIZED", "System finalized/absolute stop"); /* also: ERR_FATAL */
