/* AUTO-GENERATED by tools/ontology-sync.js -- DO NOT EDIT.
 * Source of truth: src/sys/events.h (names + comment descriptions).
 * Regenerate: node tools/ontology-sync.js
 *
 * This file is a switch body. The including file must define
 *   S(tiny, verbose)
 * selecting one literal and wrapping it in PSTR() so every string
 * is flash-resident (PROGMEM on AVR); nothing is placed in SRAM.
 */
case EVENT_NONE: return S("NONE", "No event / null");
case EVENT_INIT: return S("INIT", "Process init event");
case EVENT_POLL: return S("POLL", "Process poll request");
case EVENT_EXIT: return S("EXIT", "Process exit event");
case EVENT_LOCK_ACQ: return S("LOCK_ACQ", "Resource/lock acquired"); /* also: EVENT_ACCESS_GRANTED */
case EVENT_LOCK_REL: return S("LOCK_REL", "Resource/lock released"); /* also: EVENT_ACCESS_OK_EV */
case EVENT_HANDLE_OPEN: return S("HANDLE_OPEN", "File handle / fd opened"); /* also: EVENT_CAS_RETRY */
case EVENT_HANDLE_CLOSE: return S("HANDLE_CLOSE", "File handle / fd closed"); /* also: EVENT_CAS_DONE */
case EVENT_SOCK_BOUND: return S("SOCK_BOUND", "Socket bound to port");
case EVENT_SOCK_LISTEN: return S("SOCK_LISTEN", "Socket entered listening state");
case EVENT_CONN_ACTIVE: return S("CONN_ACTIVE", "Connection is active");
case EVENT_CONN_RESET: return S("CONN_RESET", "Connection reset by peer");
case EVENT_COLL_ADD: return S("COLL_ADD", "Item added to collection");
case EVENT_COLL_REMOVE: return S("COLL_REMOVE", "Item removed from collection");
case EVENT_PRIO_SET: return S("PRIO_SET", "Priority assigned");
case EVENT_PRIO_ADJ: return S("PRIO_ADJ", "Priority adjusted"); /* also: EVENT_PRIO_ADJ_EV */
case EVENT_GPIO_RISING: return S("GPIO_RISING", "GPIO rising edge detected");
case EVENT_GPIO_FALLING: return S("GPIO_FALLING", "GPIO falling edge detected");
case EVENT_ADC_READY: return S("ADC_READY", "ADC result ready to read");
case EVENT_SAMPLE_TICK: return S("SAMPLE_TICK", "Sample timer tick");
case EVENT_SOCK_SEC: return S("SOCK_SEC", "SOCK_SEC");
case EVENT_CONN_SEC: return S("CONN_SEC", "CONN_SEC");
case EVENT_COLL_SEC: return S("COLL_SEC", "COLL_SEC");
case EVENT_ORDER_SEC: return S("ORDER_SEC", "ORDER_SEC");
case EVENT_FILE_OPEN: return S("FILE_OPEN", "File opened");
case EVENT_FILE_CLOSE: return S("FILE_CLOSE", "File closed");
case EVENT_ATTR_READ: return S("ATTR_READ", "File attributes read");
case EVENT_ATTR_WRITE: return S("ATTR_WRITE", "File attributes written");
case EVENT_AUTH_GRANT: return S("AUTH_GRANT", "Auth/access granted");
case EVENT_AUTH_DENY_EV: return S("AUTH_DENY_EV", "Auth/access denied event");
case EVENT_SIGN_DONE: return S("SIGN_DONE", "Signing operation complete");
case EVENT_VERIFY_OK: return S("VERIFY_OK", "Signature verified");
case EVENT_MEM_ALLOC: return S("MEM_ALLOC", "Memory block allocated");
case EVENT_MEM_FREE: return S("MEM_FREE", "Memory block freed");
case EVENT_BUF_ALLOC: return S("BUF_ALLOC", "Buffer allocated");
case EVENT_BUF_FREE: return S("BUF_FREE", "Buffer freed");
case EVENT_SYS_READY: return S("SYS_READY", "System/module ready");
case EVENT_MODULE_INIT: return S("MODULE_INIT", "Module initialized");
case EVENT_STATE_ENTER: return S("STATE_ENTER", "FSM state entered");
case EVENT_STATE_EXIT: return S("STATE_EXIT", "FSM state exited");
case EVENT_GPIO_SEC: return S("GPIO_SEC", "GPIO_SEC");
case EVENT_ADC_SEC: return S("ADC_SEC", "ADC_SEC");
case EVENT_NET_DOM: return S("NET_DOM", "NET_DOM");
case EVENT_TIME_DOM: return S("TIME_DOM", "TIME_DOM");
case EVENT_SERIAL_RX: return S("SERIAL_RX", "UART / serial data received");
case EVENT_SERIAL_TX: return S("SERIAL_TX", "UART / serial data sent");
case EVENT_BUS_MATCH: return S("BUS_MATCH", "Bus slave addressed / matched");
case EVENT_BUS_START: return S("BUS_START", "Bus START condition");
case EVENT_WDT_KICK: return S("WDT_KICK", "Watchdog kicked / refreshed");
case EVENT_WDT_ARMED: return S("WDT_ARMED", "Watchdog armed");
case EVENT_SYNC_DONE: return S("SYNC_DONE", "Synchronization complete");
case EVENT_SYNC_LOCK: return S("SYNC_LOCK", "Phase / clock locked");
case EVENT_ECHO_REPLY: return S("ECHO_REPLY", "Ping / echo response received");
case EVENT_RECV_READY: return S("RECV_READY", "Receive buffer has data");
case EVENT_SOCKET_RESOLVE: return S("SOCKET_RESOLVE", "Socket DNS resolved");
case EVENT_OOB_DATA: return S("OOB_DATA", "Out-of-band (urgent) data arrived");
case EVENT_LOCK_OK: return S("LOCK_OK", "Lock operation succeeded");
case EVENT_LOCK_TIMEOUT_EV: return S("LOCK_TIMEOUT_EV", "Lock acquired after wait");
case EVENT_PROC_ALIVE: return S("PROC_ALIVE", "Process is alive/running");
case EVENT_PROC_IDLE: return S("PROC_IDLE", "Process is idle/waiting");
case EVENT_FILE_SEC: return S("FILE_SEC", "FILE_SEC");
case EVENT_ATTR_SEC: return S("ATTR_SEC", "ATTR_SEC");
case EVENT_AUTH2_SEC: return S("AUTH2_SEC", "AUTH2_SEC");
case EVENT_CRYPT_SEC: return S("CRYPT_SEC", "CRYPT_SEC");
case EVENT_MEM_ALLOC_SEC: return S("MEM_ALLOC_SEC", "MEM_ALLOC_SEC");
case EVENT_BUF_SEC: return S("BUF_SEC", "BUF_SEC");
case EVENT_INIT_SEC: return S("INIT_SEC", "INIT_SEC");
case EVENT_STATE_SEC: return S("STATE_SEC", "STATE_SEC");
case EVENT_PIPE_READY: return S("PIPE_READY", "Pipe has data ready");
case EVENT_PIPE_OPEN: return S("PIPE_OPEN", "Pipe connection opened");
case EVENT_PROC_STARTED: return S("PROC_STARTED", "Process scheduled/started");
case EVENT_PROC_STOPPED: return S("PROC_STOPPED", "Process removed/stopped");
case EVENT_DNS_QUERY: return S("DNS_QUERY", "DNS query sent");
case EVENT_DNS_REPLY: return S("DNS_REPLY", "DNS reply received");
case EVENT_PROTO_SHAKE: return S("PROTO_SHAKE", "Protocol handshake initiated");
case EVENT_PROTO_ACK: return S("PROTO_ACK", "Protocol step acknowledged");
case EVENT_MSG_PUSH: return S("MSG_PUSH", "Message pushed to queue; also dual of ERR_QUEUE_CLEAR(0xB3)");
case EVENT_MSG_POP: return S("MSG_POP", "Message popped from queue"); /* also: EVENT_CALIBRATE */
case EVENT_TIMER: return S("TIMER", "Timer fired");
case EVENT_INTERVAL: return S("INTERVAL", "Periodic interval tick");
case EVENT_BUS_STOP: return S("BUS_STOP", "Bus STOP condition");
case EVENT_BUS_TX_DONE: return S("BUS_TX_DONE", "Bus transmit acknowledged");
case EVENT_DEVICE_DATA: return S("DEVICE_DATA", "Device data available");
case EVENT_DEVICE_READY: return S("DEVICE_READY", "Device ready for next op");
case EVENT_SIGNAL_DOM: return S("SIGNAL_DOM", "SIGNAL_DOM");
case EVENT_SYNC: return S("SYNC", "External I/O oscillation");
case EVENT_SERIAL_SEC: return S("SERIAL_SEC", "SERIAL_SEC");
case EVENT_BUS_SEC: return S("BUS_SEC", "BUS_SEC");
case EVENT_VOL_MOUNT: return S("VOL_MOUNT", "Volume mounted");
case EVENT_VOL_SYNC: return S("VOL_SYNC", "Volume flushed/synced");
case EVENT_BLK_READ: return S("BLK_READ", "Block read complete");
case EVENT_BLK_WRITE: return S("BLK_WRITE", "Block write complete");
case EVENT_POLICY_OK: return S("POLICY_OK", "Policy check passed");
case EVENT_QUOTA_OK: return S("QUOTA_OK", "Quota / rate-limit OK");
case EVENT_AUDIT_WRITE: return S("AUDIT_WRITE", "Audit log entry written");
case EVENT_AUDIT_DONE: return S("AUDIT_DONE", "Audit cycle complete");
case EVENT_ENCRYPT_BEGIN: return S("ENCRYPT_BEGIN", "Encryption operation started");
case EVENT_ENCRYPT_DONE: return S("ENCRYPT_DONE", "Encryption operation complete");
case EVENT_AUTH_REQUEST: return S("AUTH_REQUEST", "Auth challenge issued");
case EVENT_AUTH_OK: return S("AUTH_OK", "Authentication succeeded");
case EVENT_REF_INC: return S("REF_INC", "Reference count incremented");
case EVENT_REF_DEC: return S("REF_DEC", "Reference count decremented");
case EVENT_CLEANUP_DONE: return S("CLEANUP_DONE", "Cleanup completed");
case EVENT_RESOURCE_REL: return S("RESOURCE_REL", "Resource released");
case EVENT_WDT_SEC: return S("WDT_SEC", "WDT_SEC");
case EVENT_SYNC_SEC: return S("SYNC_SEC", "SYNC_SEC");
case EVENT_NETDATA_SEC: return S("NETDATA_SEC", "NETDATA_SEC");
case EVENT_NETCTRL_SEC: return S("NETCTRL_SEC", "NETCTRL_SEC");
case EVENT_CMD_RECV: return S("CMD_RECV", "CLI/AT/RPC command received"); /* also: EVENT_MOUSE */
case EVENT_TEXT_RECV: return S("TEXT_RECV", "UTF-8 text string received"); /* also: EVENT_CHAR */
case EVENT_KEY_DOWN: return S("KEY_DOWN", "Physical key pressed");
case EVENT_KEY_UP: return S("KEY_UP", "Physical key released");
case EVENT_CLK_READY: return S("CLK_READY", "Clock source ready");
case EVENT_CLK_STABLE: return S("CLK_STABLE", "Clock stable / locked");
case EVENT_IRQ_FIRED: return S("IRQ_FIRED", "Hardware interrupt triggered");
case EVENT_IRQ_ACK: return S("IRQ_ACK", "Interrupt acknowledged");
case EVENT_SOCKET_DISCONN: return S("SOCKET_DISCONN", "Connection closed by peer");
case EVENT_SOCKET_SHUTDOWN: return S("SOCKET_SHUTDOWN", "Half-close (shutdown) initiated");
case EVENT_CHANNEL_REQ: return S("CHANNEL_REQ", "HTTP/WS request received");
case EVENT_CHANNEL_RESP: return S("CHANNEL_RESP", "HTTP/WS response received");
case EVENT_HANDLE_FRESH: return S("HANDLE_FRESH", "Fresh handle replaced stale one");
case EVENT_HANDLE_RETYPE: return S("HANDLE_RETYPE", "Handle type corrected/cast");
case EVENT_CRIT_PERMIT: return S("CRIT_PERMIT", "Forbidden op now permitted");
case EVENT_CRIT_UNLOCK: return S("CRIT_UNLOCK", "Lock forcibly released");
case EVENT_ARG_SEC: return S("ARG_SEC", "ARG_SEC");
case EVENT_PSCHED_SEC: return S("PSCHED_SEC", "PSCHED_SEC");
case EVENT_STORAGE_DOM: return S("STORAGE_DOM", "STORAGE_DOM");
case EVENT_SEC_DOM: return S("SEC_DOM", "SEC_DOM");
case EVENT_MEM_DOM: return S("MEM_DOM", "MEM_DOM");
case EVENT_LIFE_DOM: return S("LIFE_DOM", "LIFE_DOM");
case EVENT_IPC: return S("IPC", "IPC");
case EVENT_PROC_STATE: return S("PROC_STATE", "PROC_STATE");
case EVENT_CRIT_ENTER: return S("CRIT_ENTER", "Critical section entered"); /* also: EVENT_UNLOCK_DONE */
case EVENT_CRIT_EXIT: return S("CRIT_EXIT", "Critical section exited"); /* also: EVENT_PERMIT_OK */
case EVENT_HANDLE_READY: return S("HANDLE_READY", "Handle ready for I/O"); /* also: EVENT_HANDLE_REL */
case EVENT_HANDLE_WAKE: return S("HANDLE_WAKE", "Stale/dormant handle resumed"); /* also: EVENT_ATOMIC_OK, EVENT_HANDLE_ACQ */
case EVENT_SOCK_ACCEPT: return S("SOCK_ACCEPT", "Incoming connection accepted");
case EVENT_SOCK_OPEN: return S("SOCK_OPEN", "Outbound connection established");
case EVENT_CONN_CLOSE: return S("CONN_CLOSE", "Connection closed");
case EVENT_CONN_KEEP: return S("CONN_KEEP", "Keepalive acknowledged");
case EVENT_COLL_UPDATE: return S("COLL_UPDATE", "Item in collection updated");
case EVENT_COLL_READY: return S("COLL_READY", "Collection ready for access");
case EVENT_ORDER_DONE: return S("ORDER_DONE", "Ordering/sort complete");
case EVENT_ORDER_CHANGE: return S("ORDER_CHANGE", "Order changed/requeued");
case EVENT_GPIO_CHANGE: return S("GPIO_CHANGE", "GPIO level change (both edges)");
case EVENT_GPIO_MODE: return S("GPIO_MODE", "GPIO pin mode changed");
case EVENT_DAC_DONE: return S("DAC_DONE", "DAC output complete");
case EVENT_CONV_COMPLETE: return S("CONV_COMPLETE", "ADC/DAC conversion complete");
case EVENT_DNS_SEC: return S("DNS_SEC", "DNS_SEC");
case EVENT_PROTO_SEC: return S("PROTO_SEC", "PROTO_SEC");
case EVENT_MSGQ_SEC: return S("MSGQ_SEC", "MSGQ_SEC");
case EVENT_TIMER_SEC: return S("TIMER_SEC", "TIMER_SEC");
case EVENT_FILE_DELETE: return S("FILE_DELETE", "File deleted");
case EVENT_FILE_RENAME: return S("FILE_RENAME", "File renamed");
case EVENT_ATTR_CHANGE: return S("ATTR_CHANGE", "File attributes changed");
case EVENT_ATTR_WATCH: return S("ATTR_WATCH", "File attribute watch registered");
case EVENT_CERT_OK: return S("CERT_OK", "Certificate/credential verified");
case EVENT_CERT_ISSUE: return S("CERT_ISSUE", "Certificate/credential issued");
case EVENT_KEY_DERIVED: return S("KEY_DERIVED", "Key derivation complete");
case EVENT_HASH_DONE: return S("HASH_DONE", "Hash computation complete");
case EVENT_MEM_COMPACT: return S("MEM_COMPACT", "Memory compacted/defraged");
case EVENT_MEM_GC: return S("MEM_GC", "GC cycle completed");
case EVENT_BUF_READY: return S("BUF_READY", "Buffer ready for write");
case EVENT_BUF_FLUSH: return S("BUF_FLUSH", "Buffer flushed to stream");
case EVENT_DEP_OK: return S("DEP_OK", "Dependency satisfied");
case EVENT_REINIT: return S("REINIT", "Module reinitialized");
case EVENT_STATE_STABLE: return S("STATE_STABLE", "FSM state stabilized");
case EVENT_STATE_CHANGE: return S("STATE_CHANGE", "FSM state transition");
case EVENT_SDATA_SEC: return S("SDATA_SEC", "SDATA_SEC");
case EVENT_DATA_SEC: return S("DATA_SEC", "DATA_SEC");
case EVENT_FLOW: return S("FLOW", "Internal data flow");
case EVENT_IO_DOM: return S("IO_DOM", "IO_DOM");
case EVENT_SERIAL_OPEN: return S("SERIAL_OPEN", "Serial port opened");
case EVENT_SERIAL_CLOSE: return S("SERIAL_CLOSE", "Serial port closed");
case EVENT_BUS_RX: return S("BUS_RX", "Bus data received"); /* also: EVENT_BUTTON */
case EVENT_BUS_TX: return S("BUS_TX", "Bus transmit buffer sent"); /* also: EVENT_BUTTON_UP */
case EVENT_WDT_DISARMED: return S("WDT_DISARMED", "Watchdog disarmed");
case EVENT_POWER_OK: return S("POWER_OK", "System power stable"); /* also: EVENT_IDLE_ENTER */
case EVENT_BARRIER_PASS: return S("BARRIER_PASS", "Barrier passed");
case EVENT_PHASE_LOCK: return S("PHASE_LOCK", "Phase lock achieved");
case EVENT_HANDSHAKE_DONE: return S("HANDSHAKE_DONE", "TLS/WS handshake complete");
case EVENT_SEND_READY: return S("SEND_READY", "Send buffer has free space");
case EVENT_SOCKET_FRAME: return S("SOCKET_FRAME", "UDP packet / WS data frame arrived");
case EVENT_SOCKET_KEEP: return S("SOCKET_KEEP", "Socket keepalive received");
case EVENT_DEADLOCK_RESOLVED: return S("DEADLOCK_RESOLVED", "Deadlock resolved"); /* also: EVENT_SHUTDOWN */
case EVENT_OWNER_CHANGED: return S("OWNER_CHANGED", "Lock owner changed");
case EVENT_MSG_SENT: return S("MSG_SENT", "IPC message sent");
case EVENT_MSG_DELIVERED: return S("MSG_DELIVERED", "IPC message delivered");
case EVENT_VOL_SEC: return S("VOL_SEC", "VOL_SEC");
case EVENT_BLK_SEC: return S("BLK_SEC", "BLK_SEC");
case EVENT_POLICY_SEC: return S("POLICY_SEC", "POLICY_SEC");
case EVENT_AUDIT_SEC: return S("AUDIT_SEC", "AUDIT_SEC");
case EVENT_ENC_SEC: return S("ENC_SEC", "ENC_SEC");
case EVENT_AUTH_SEC: return S("AUTH_SEC", "AUTH_SEC");
case EVENT_REF_SEC: return S("REF_SEC", "REF_SEC");
case EVENT_CLEAN_SEC: return S("CLEAN_SEC", "CLEAN_SEC");
case EVENT_PIPE_CLOSE: return S("PIPE_CLOSE", "Pipe connection closed");
case EVENT_PIPE_FLUSH: return S("PIPE_FLUSH", "Pipe data flushed");
case EVENT_PROC_PAUSED: return S("PROC_PAUSED", "Process execution paused");
case EVENT_PROC_RESUMED: return S("PROC_RESUMED", "Process execution resumed");
case EVENT_DNS_CACHED: return S("DNS_CACHED", "DNS result from cache");
case EVENT_DNS_OK: return S("DNS_OK", "DNS resolution complete");
case EVENT_CHANNEL_UP: return S("CHANNEL_UP", "Channel/session established");
case EVENT_CHANNEL_DOWN: return S("CHANNEL_DOWN", "Channel/session closed");
case EVENT_MSG_ACK: return S("MSG_ACK", "Message acknowledged"); /* also: EVENT_WHEEL */
case EVENT_MSG_FLUSH: return S("MSG_FLUSH", "Message queue flushed"); /* also: EVENT_TOUCH */
case EVENT_HEARTBEAT: return S("HEARTBEAT", "Heartbeat / health-check tick"); /* also: EVENT_GESTURE */
case EVENT_FRAME_BEGIN: return S("FRAME_BEGIN", "Frame / cycle start"); /* also: EVENT_SENSOR */
case EVENT_BUS_RX_DONE: return S("BUS_RX_DONE", "Bus receive complete");
case EVENT_BUS_DONE: return S("BUS_DONE", "Bus transaction complete");
case EVENT_DATA_VALID: return S("DATA_VALID", "Data validated / checked");
case EVENT_DATA_RECV: return S("DATA_RECV", "Data received and buffered");
case EVENT_TIMING_DOM: return S("TIMING_DOM", "TIMING_DOM");
case EVENT_NET_DATA_DOM: return S("NET_DATA_DOM", "NET_DATA_DOM");
case EVENT_INPUT_SEC: return S("INPUT_SEC", "INPUT_SEC");
case EVENT_KEY_SEC: return S("KEY_SEC", "KEY_SEC");
case EVENT_VOL_UNMOUNT: return S("VOL_UNMOUNT", "Volume unmounted");
case EVENT_VOL_TRIM: return S("VOL_TRIM", "Volume TRIM/erase issued");
case EVENT_BLK_ERASE: return S("BLK_ERASE", "Block erased");
case EVENT_BLK_VERIFY: return S("BLK_VERIFY", "Block verify complete");
case EVENT_RATE_OK: return S("RATE_OK", "Rate limit not exceeded");
case EVENT_POLICY_RESET: return S("POLICY_RESET", "Policy counters reset");
case EVENT_LOG_SYNC: return S("LOG_SYNC", "Audit log flushed/synced");
case EVENT_LOG_OK: return S("LOG_OK", "Log integrity verified");
case EVENT_DECRYPT_BEGIN: return S("DECRYPT_BEGIN", "Decryption operation started");
case EVENT_DECRYPT_DONE: return S("DECRYPT_DONE", "Decryption operation complete");
case EVENT_AUTH_REVOKE: return S("AUTH_REVOKE", "Auth token revoked");
case EVENT_AUTH_EXPIRE: return S("AUTH_EXPIRE", "Auth token expired");
case EVENT_REF_ZERO: return S("REF_ZERO", "Reference count reached zero");
case EVENT_REF_RELEASE: return S("REF_RELEASE", "Object fully released");
case EVENT_RESOURCE_CLR: return S("RESOURCE_CLR", "Resource cleared/reset");
case EVENT_RESOURCE_FREE: return S("RESOURCE_FREE", "Resource freed");
case EVENT_CLK_SEC: return S("CLK_SEC", "CLK_SEC");
case EVENT_IRQ_SEC: return S("IRQ_SEC", "IRQ_SEC");
case EVENT_NETSTATE_SEC: return S("NETSTATE_SEC", "NETSTATE_SEC");
case EVENT_CHANNEL_SEC: return S("CHANNEL_SEC", "CHANNEL_SEC");
case EVENT_TEXT_START: return S("TEXT_START", "IME composition started"); /* also: EVENT_BUTTON_DBL */
case EVENT_TEXT_END: return S("TEXT_END", "IME composition ended"); /* also: EVENT_MOTION */
case EVENT_KEY_REPEAT: return S("KEY_REPEAT", "Key auto-repeat event");
case EVENT_KEY_ALT: return S("KEY_ALT", "Non-printable / alternate key");
case EVENT_FRAME_END: return S("FRAME_END", "Frame / cycle ended");
case EVENT_FRAME_SYNC: return S("FRAME_SYNC", "Frame synchronised");
case EVENT_IRQ_DONE: return S("IRQ_DONE", "Interrupt service routine done");
case EVENT_IRQ_CLEAR: return S("IRQ_CLEAR", "Interrupt flag cleared");
case EVENT_SOCKET_ERROR: return S("SOCKET_ERROR", "Network error (data=error_code)");
case EVENT_NET_DOWN: return S("NET_DOWN", "Network interface down");
case EVENT_CHANNEL_UPG: return S("CHANNEL_UPG", "Protocol upgrade (HTTP->WS)");
case EVENT_OOB_RECV: return S("OOB_RECV", "Out-of-band receipt confirmed");
case EVENT_HANDLE_REOPEN: return S("HANDLE_REOPEN", "Closed handle reopened");
case EVENT_HANDLE_VALID: return S("HANDLE_VALID", "Handle validated/re-opened");
case EVENT_ACCESS_ALLOW: return S("ACCESS_ALLOW", "Read-only resource made writable");
case EVENT_ACCESS_REVOKE: return S("ACCESS_REVOKE", "Access/lock forcibly revoked");
case EVENT_SYS_HANDLE_EV: return S("SYS_HANDLE_EV", "Dual of ERR_SYS_HANDLE(0x03)");
case EVENT_SYS_ACCESS_EV: return S("SYS_ACCESS_EV", "Dual of ERR_SYS_ACCESS(0x02)");
case EVENT_PSTATE_DOM: return S("PSTATE_DOM", "PSTATE_DOM");
case EVENT_ERROR: return S("ERROR", "Error occurred (carries error)");
